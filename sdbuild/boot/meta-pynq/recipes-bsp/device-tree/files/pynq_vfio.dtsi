/ {
	amba {
		fabric-vfio@80000000 {
			compatible = "vfio-platform";
			reg = <0x0 0x80000000 0x0 0x40000000>;
			iommus = <&smmu 0x200>, <&smmu 0x201>, <&smmu 0x240>, <&smmu 0x241>, <&smmu 0xe80>, <&smmu 0xe81>, <&smmu 0x12c0>, <&smmu 0x12c1>, <&smmu 0x1300>, <&smmu 0x1301>, <&smmu 0x1740>, <&smmu 0x1741>, <&smmu 0xbc0>, <&smmu 0xbc1>;
		};

	};
};

&smmu {
	status = "okay";
};
